## image/minimal/Config.in
```kconfig
source "$BR2_EXTERNAL_SATOOSHI_PATH/package/python-mnemonic/Config.in"
source "$BR2_EXTERNAL_SATOOSHI_PATH/package/python-embit/Config.in"
source "$BR2_EXTERNAL_SATOOSHI_PATH/package/satooshi-native/Config.in"
source "$BR2_EXTERNAL_SATOOSHI_PATH/package/satooshi-runtime/Config.in"
```

## image/minimal/package/python-embit/Config.in
```kconfig
config BR2_PACKAGE_PYTHON_EMBIT
	bool "Satooshi embit"
	depends on BR2_PACKAGE_PYTHON3
```

## image/minimal/package/python-mnemonic/Config.in
```kconfig
config BR2_PACKAGE_PYTHON_MNEMONIC
	bool "Satooshi BIP39 mnemonic"
	depends on BR2_PACKAGE_PYTHON3
```

## image/minimal/package/satooshi-native/Config.in
```kconfig
config BR2_PACKAGE_SATOOSHI_NATIVE
	bool "Satooshi native signing bridge"
	depends on BR2_PACKAGE_HOST_RUSTC_TARGET_ARCH_SUPPORTS
```

## image/minimal/package/satooshi-runtime/Config.in
```kconfig
config BR2_PACKAGE_SATOOSHI_RUNTIME
	bool "Satooshi wallet runtime"
	depends on BR2_PACKAGE_PYTHON3
```
